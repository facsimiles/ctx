/* !!!!!!!!!!!!!!!!!!!!!!!!!!!!!!!!!!!!!!!!!!!!! */
/* this file is autogenerated by ./argvs_extract.sh */
/* !!!!!!!!!!!!!!!!!!!!!!!!!!!!!!!!!!!!!!!!!!!!! */
int cmd_aa_help (COMMAND_ARGS);
int cmd_activate (COMMAND_ARGS);
int cmd_argvs (COMMAND_ARGS);
int cmd_duplicate (COMMAND_ARGS);
int cmd_edit_text_end (COMMAND_ARGS);
int cmd_edit_text_home (COMMAND_ARGS);
int cmd_go_parent (COMMAND_ARGS);
int cmd_history (COMMAND_ARGS);
int cmd_move (COMMAND_ARGS);
int cmd_page (COMMAND_ARGS);
int cmd_remove (COMMAND_ARGS);
int cmd_source (COMMAND_ARGS);
int dir_enter_children (COMMAND_ARGS);
int dir_follow_link (COMMAND_ARGS);
int dir_insert (COMMAND_ARGS);
int dir_parent (COMMAND_ARGS);
int dir_zoom (COMMAND_ARGS);
int focus_next (COMMAND_ARGS);
int focus_next_link (COMMAND_ARGS);
int focus_next_sibling (COMMAND_ARGS);
int focus_previous (COMMAND_ARGS);
int focus_previous_link (COMMAND_ARGS);
int focus_previous_sibling (COMMAND_ARGS);
int item_cycle_bullet(COMMAND_ARGS);
int item_cycle_heading (COMMAND_ARGS);
int item_properties (COMMAND_ARGS);
int make_child_of_previous (COMMAND_ARGS);
int make_sibling_of_parent (COMMAND_ARGS);
int move_after_next_sibling (COMMAND_ARGS);
int move_before_previous_sibling (COMMAND_ARGS);
int outline_collapse (COMMAND_ARGS);
int outline_expand (COMMAND_ARGS);
int toggle_keybindings_display (COMMAND_ARGS);
void argvs_register(void) {
 argvs_add (cmd_aa_help ,  "?", 0, "[command]", "get's help about a coloritto command" );
 argvs_add (cmd_activate ,  "activate", 0, "", "activate item" );
 argvs_add (cmd_argvs ,  "argvs", 0, "<script | -c <command> >", "the minimalistic shell with int argc, char **argv semantics you now use" );
 argvs_add (cmd_duplicate ,  "duplicate", 0, "", "duplicate item" );
 argvs_add (cmd_edit_text_end ,  "edit-text-end", 0, "", "edit end of line" );
 argvs_add (cmd_edit_text_home ,  "edit-text-home", 0, "", "edit start of line" );
 argvs_add (cmd_go_parent ,  "go-parent", 0, "", "" );
 argvs_add (cmd_history ,  "history", 1, "<forward|back>", "moved history forward or back" );
 argvs_add (cmd_move ,  "move", 1, "<up|left|right|down>", "shift items position" );
 argvs_add (cmd_page ,  "page", 1, "<next|prev|previous|integer>", "" );
 argvs_add (cmd_remove ,  "remove", 0, "", "remove item" );
 argvs_add (cmd_source ,  ".", 1, "<path>", "sources script at path");
 argvs_add (dir_enter_children ,  "enter-children", 0, "", "" );
 argvs_add (dir_follow_link ,  "follow-link", 0, "", "" );
 argvs_add (dir_insert ,  "insert-text", 0, "", "" );
 argvs_add (dir_parent ,  "parent", 0, "", "" );
 argvs_add (dir_zoom ,  "zoom", 1, "<in|out|val>", "" );
 argvs_add (focus_next ,  "focus-next", 0, "", "" );
 argvs_add (focus_next_link ,  "focus-next-link", 0, "", "" );
 argvs_add (focus_next_sibling ,  "focus-next-sibling", 0, "", "" );
 argvs_add (focus_previous ,  "focus-previous", 0, "", "" );
 argvs_add (focus_previous_link ,  "focus-previous-link", 0, "", "" );
 argvs_add (focus_previous_sibling ,  "focus-previous-sibling", 0, "", "" );
 argvs_add (item_cycle_bullet,  "cycle-bullet", 0, "", "" );
 argvs_add (item_cycle_heading ,  "cycle-heading", 0, "", "" );
 argvs_add (item_properties ,  "toggle-context", 0, "", "" );
 argvs_add (make_child_of_previous ,  "make-child-of-previous", 0, "", "" );
 argvs_add (make_sibling_of_parent ,  "make-sibling-of-parent", 0, "", "" );
 argvs_add (move_after_next_sibling ,  "move-after-next-sibling", 0, "", "" );
 argvs_add (move_before_previous_sibling ,  "move-before-previous-sibling", 0, "", "" );
 argvs_add (outline_collapse ,  "fold", 0, "", "" );
 argvs_add (outline_expand ,  "expand", 0, "", "" );
 argvs_add (toggle_keybindings_display ,  "toggle-keybindings-display", 0, "", "");
};
